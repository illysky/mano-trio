## boards/arm/nslog/Kconfig.defconfig
```kconfig
# Copyright (c) 2022 Nordic Semiconductor ASA
# SPDX-License-Identifier: Apache-2.0

if BOARD_NSLOG

config BOARD
	default "nslog"

config BT_CTLR
   default BT

endif
```

## boards/arm/nslog/nslog_defconfig
```kconfig
# Copyright (c) 2022 Nordic Semiconductor ASA
# SPDX-License-Identifier: Apache-2.0
CONFIG_SOC_SERIES_NRF52X=y
CONFIG_SOC_NRF52833_QIAA=y
CONFIG_BOARD_NSLOG=y


# Enable MPU
CONFIG_ARM_MPU=y
CONFIG_SERIAL=y


# Peripherals





# Make sure our expander is configured first as its needed for a few things. 
CONFIG_GPIO_AS_PINRESET=n #  
```

## boards/nooshee/log/Kconfig.defconfig
```kconfig
if BOARD_LOG

config BT_CTLR
	default BT

config HW_STACK_PROTECTION
	default ARCH_HAS_STACK_PROTECTION

endif # 
```

## boards/nooshee/log/log_nrf52833_defconfig
```kconfig
# Copyright (c) 2022 Nordic Semiconductor ASA
# SPDX-License-Identifier: Apache-2.0


# Enable MPU
CONFIG_ARM_MPU=y
CONFIG_SERIAL=y
CONFIG_I2C=y
CONFIG_SPI=y
CONFIG_GPIO=y

# Peripherals
```

## oot/drivers/Kconfig
```kconfig
rsource "charger/Kconfig"
rsource "display/Kconfig"
rsource "led/Kconfig"
rsource "sensor/Kconfig"
```

## oot/drivers/charger/bq25792/Kconfig
```kconfig
config CHARGER_BQ25792
	bool "bq25792"
	default n
	depends on DT_HAS_TI_BQ25792_ENABLED
	select I2C
	select CHARGER
	help
	  Enable BQ25792 CHARGER driver.
```

## oot/drivers/charger/bq25792/dts/bindings/ti,bq25792.yaml
```yaml
description: Driver for TI bq25792
compatible: "ti,bq25792"
# Add properties includes manually
include: [i2c-device.yaml]
# Add properties manually
properties:
    ce-gpios:
      type: phandle-array
      description: Chip enable pin

    irq-gpios:
      type: phandle-array
      description: Interrupt request pin

    charge-ilim:
      description: Charge current
      required: true
      type: int

    input-ilim:
      description: Charge current
      required: true
      type: int
```

## oot/drivers/display/ssd1309/Kconfig
```kconfig
# SSD1309 display controller configuration options

# Copyright (c) 2018 Phytec Messtechnik GmbH
# SPDX-License-Identifier: Apache-2.0

menuconfig SSD1309
	bool "SSD1309 display driver"
	default y
	depends on DT_HAS_SOLOMON_SSD1309FB_ENABLED
	select I2C if $(dt_compat_on_bus,$(DT_COMPAT_SOLOMON_SSD1309FB),i2c)
	select SPI if $(dt_compat_on_bus,$(DT_COMPAT_SOLOMON_SSD1309FB),spi)
	help
	  Enable driver for SSD1309 display driver.

if SSD1309

config SSD1309_DEFAULT_CONTRAST
	int "SSD1309 default contrast"
	default 128
	range 0 255
	help
	  SSD1309 default contrast.

choice SSD1309_CONTROLLER_TYPE
	prompt "Display controller type"
	default SSD1309_DEFAULT
	help
	  Specify the type of the controller.

config SSD1309_DEFAULT
	bool "Default SSD1309 controller"

config SSD1309_SH1106_COMPATIBLE
	bool "SH1106 compatible mode"

endchoice

config SSD1309_REVERSE_MODE
	bool "SSD1309 reverse mode"
	help
	  SSD1309 reverse video mode.


module = SSD1309
module-str = ssd1309
source "subsys/logging/Kconfig.template.log_config"


endif # SSD1309
```

## oot/drivers/led/aw21036/Kconfig
```kconfig
config AW21036
	bool "aw21036"
	default n
	depends on DT_HAS_AWINIC_AW21036_ENABLED
	select I2C
	select LED
	help
	  Enable AW21036 LED driver.
```

## oot/drivers/led/aw9109/Kconfig
```kconfig
# Copyright (c) 2018 Savoir-Faire Linux
# SPDX-License-Identifier: Apache-2.0

config AW9109
	bool "AW9109 LED driver"
	default y
	depends on DT_HAS_AWINIC_AW9109_ENABLED
	select I2C
	help
	  Enable LED driver for AW9109.
	  AW9109 LED driver has 9 channels with constant current


if AW9109

config AW9109_CURRENT_CHANNEL_0
	int "AW9109 Channel 0 CC"
	default 0
	range 0 7
	help
	  AW9109 Channel 0 CC

config AW9109_CURRENT_CHANNEL_1
	int "AW9109 Channel 1 CC"
	default 0
	range 0 7
	help
	  AW9109 Channel 1 CC

config AW9109_CURRENT_CHANNEL_2
	int "AW9109 Channel 2 CC"
	default 0
	range 0 7
	help
	  AW9109 Channel 2 CC

config AW9109_CURRENT_CHANNEL_3
	int "AW9109 Channel 3 CC"
	default 0
	range 0 7
	help
	  AW9109 Channel 3 CC

config AW9109_CURRENT_CHANNEL_4
	int "AW9109 Channel 4 CC"
	default 0
	range 0 7
	help
	  AW9109 Channel 4 CC

config AW9109_CURRENT_CHANNEL_5
	int "AW9109 Channel 5 CC"
	default 0
	range 0 7
	help
	  AW9109 Channel 5 CC

config AW9109_CURRENT_CHANNEL_6
	int "AW9109 Channel 6 CC"
	default 0
	range 0 7
	help
	  AW9109 Channel 6 CC

config AW9109_CURRENT_CHANNEL_7
	int "AW9109 Channel 7 CC"
	default 0
	range 0 7
	help
	  AW9109 Channel 7 CC

config AW9109_CURRENT_CHANNEL_8
	int "AW9109 Channel 8 CC"
	default 0
	range 0 7
	help
	  AW9109 Channel 8 CC

module = AW9109
module-str = ssd9109
source "subsys/logging/Kconfig.template.log_config"


endif # SSD1309
```

## oot/drivers/sensor/Kconfig
```kconfig
rsource "hx711/Kconfig"
rsource "mxc6655xa/Kconfig"
rsource "paa5100/Kconfig"
rsource "vcnl4010/Kconfig"
```

## oot/drivers/sensor/mxc6655xa/Kconfig
```kconfig
config SENSOR_MXC6655XA
	bool "mxc6655xa"
	default n
	depends on DT_HAS_MEMSIC_MXC6655XA_ENABLED
	select I2C
	select SENSOR
	help
	  Enable MXC6655XA SENSOR driver.
```

## oot/drivers/sensor/paa5100/Kconfig
```kconfig
# Sensor data simulator
#
# Copyright (c) 2019 Nordic Semiconductor
#
# SPDX-License-Identifier: LicenseRef-Nordic-5-Clause
#

menuconfig SENSOR_PAA5100
	bool "PAA5100 mouse optical sensor"
	depends on SPI
	help
	  Enable PAA5100 mouse optical sensor.

if SENSOR_PAA5100

config SENSOR_PAA5100_CPI
	int "PAA5100's default CPI"
	default 1600
	range 100 12000
	help
	  Default CPI value.

config SENSOR_PAA5100_RUN_DOWNSHIFT_TIME_MS
	int "PAA5100's default RUN mode downshift time"
	default 500
	range 10 2550
	help
	  Default RUN mode downshift down time in milliseconds.
	  Time after which sensor goes from RUN to REST1 mode.

config SENSOR_PAA5100_REST1_DOWNSHIFT_TIME_MS
	int "PAA5100's default REST1 mode downshift time"
	default 9220
	range 320 81600
	help
	  Default REST1 mode downshift down time in milliseconds.
	  Time after which sensor goes from REST1 to REST2 mode.

config SENSOR_PAA5100_REST2_DOWNSHIFT_TIME_MS
	int "PAA5100's default REST2 mode downshift time"
	default 150000
	range 3200 816000
	help
	  Default REST2 mode downshift down time in milliseconds.
	  Time after which sensor goes from REST2 to REST3 mode.

choice
	prompt "Select PAA5100 sensor orientation"
	default SENSOR_PAA5100_ORIENTATION_0

config SENSOR_PAA5100_ORIENTATION_0
	bool "PAA5100 not rotated"

config SENSOR_PAA5100_ORIENTATION_90
	bool "PAA5100 rotated 90 deg clockwise"

config SENSOR_PAA5100_ORIENTATION_180
	bool "PAA5100 rotated 180 deg clockwise"

config SENSOR_PAA5100_ORIENTATION_270
	bool "PAA5100 rotated 270 deg clockwise"


endchoice

module = PAA5100
module-str = paa5100

source "${ZEPHYR_BASE}/subsys/logging/Kconfig.template.log_config"

endif #PAA5100
```

## oot/drivers/sensor/vcnl4010/Kconfig
```kconfig
config SENSOR_VCNL4010
	bool "vcnl4010"
	default n
	depends on DT_HAS_VISHAY_VCNL4010_ENABLED
	select I2C
	select SENSOR
	help
	  Enable VCNL4010 SENSOR driver.
```

## oot/drivers/usb_pd/fusb302/Kconfig
```kconfig
# SSD1309 display controller configuration options

# Copyright (c) 2018 Phytec Messtechnik GmbH
# SPDX-License-Identifier: Apache-2.0

menuconfig FUSB302
	bool "FUSB302 USB-C PD Driver"
	depends on I2C
	help
	  Enable driver for FUSB302 USB-C PD Driver

if FUSB302

config FUSB302_INIT_PRIORITY
	int "Initialisation priority"
	default 80

module = FUSB302
module-str = fusb302
source "subsys/logging/Kconfig.template.log_config"

endif # SSD1309
```

## oot/drivers/usb_pd/fusb302/dts/bindings/onsemi,fusb302.yaml
```yaml
description: ONSEMI FUSB302 PD Driver

compatible: "onsemi,fusb302"

include: i2c-device.yaml

properties:
    irqn-gpios:
      type: phandle-array
      required: false
      description: IRQN pin
```

## oot/dts/bindings/display/solomon,ssd1309fb-i2c.yaml
```yaml
# Copyright (c) 2020, Marco Peter
# SPDX-License-Identifier: Apache-2.0

description: SSD1309 128x64 dot-matrix display controller on I2C bus
compatible: "solomon,ssd1309fb"

include: ["solomon,ssd1309fb-common.yaml", "i2c-device.yaml"]
```

## oot/dts/bindings/display/solomon,ssd1309fb-spi.yaml
```yaml
# Copyright (c) 2020, Marco Peter
# SPDX-License-Identifier: Apache-2.0

description: ssd1309 128x64 dot-matrix display controller on SPI bus

compatible: "solomon,ssd1309fb"

include: ["solomon,ssd1309fb-common.yaml", "spi-device.yaml"]

properties:
    data_cmd-gpios:
      type: phandle-array
      required: true
      description: D/C# pin.
```

## oot/dts/bindings/led/awinic,aw21036.yaml
```yaml
description: Driver for Awinic aw21036
compatible: "awinic,aw21036"
bus: i2c
# Add properties includes manually

include: [i2c-device.yaml, led-controller.yaml]

# Add properties manually
properties:
    en-gpios:
      type: phandle-array
      description: Powerdown pin, active low
```

## oot/dts/bindings/led/awinic,aw9109.yaml
```yaml
description: AWINIC AW9109 LED

compatible: "awinic,aw9109"

include: i2c-device.yaml

properties:
    pdn-gpios:
      type: phandle-array
      required: false
      description: Powerdown pin

    int-gpios:
      type: phandle-array
      required: false
      description: IRQN pin
```

## oot/dts/bindings/sensor/memsic,mxc6655xa.yaml
```yaml
description: Driver for Memsic mxc6655xa
compatible: "memsic,mxc6655xa"
# Add properties includes manually
include: [i2c-device.yaml]
# Add properties manually

properties:      
  fsr:
    description: Sampling rate of the ALS sensor
    type: int
    enum:
    - 0 # 2g
    - 1 # 4g
    - 2 # 8g
```
