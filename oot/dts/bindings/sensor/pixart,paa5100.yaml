## oot/dts/bindings/sensor/pixart,paa5100.yaml
```yaml
#
# Copyright (c) 2019 Nordic Semiconductor
#
# SPDX-License-Identifier: LicenseRef-Nordic-5-Clause
#


description: |
    This is a representation of the PAA5100 optical motion sensor

compatible: "pixart,paa5100"

include: spi-device.yaml

properties:
    irq-gpios:
      type: phandle-array
      required: true

on-bus: spi
```

## oot/dts/bindings/sensor/vishay,vcnl4010.yaml
```yaml
description: Driver for Vishay vcnl4010
compatible: "vishay,vcnl4010"
# Add properties includes manually
include: [i2c-device.yaml]
# Add properties manually

properties:
    prox-rate:
      description: Sampling rate of the prox sensor
      type: int
      enum:
      - 0 # 1.95 measurements/s (DEFAULT)
      - 1 # 3.90625 measurements/s
      - 2 # 7.8125 measurements/s
      - 3 # 16.625 measurements/s
      - 4 # 31.25 measurements/s
      - 5 # 62.5 measurements/s
      - 6 # 125 measurements/s
      - 7 # 250 measurements/s

    als-rate:
      description: Sampling rate of the ALS sensor
      type: int
      enum:
      - 0 # 1 samples/s
      - 1 # 2 samples/s = DEFAULT
      - 2 # 3 samples/s
      - 3 # 4 samples/s
      - 4 # 5 samples/s
      - 5 # 6 samples/s
      - 6 # 8 samples/s
      - 7 # 10 samples/s

    iled:
      description: Current sent to the IR LED
      type: int

    sel-gpios:
      type: phandle-array
      description: select pin

    id:
      description: Selection
      type: int
      enum:
      - 0
      - 1
```
